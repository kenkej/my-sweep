/*
 * Let any key wake this half from soft off (kscan0 already has
 * wakeup-source; set upstream in cradio.dtsi).
 */

/ {
    soft_off_wakers {
        compatible = "zmk,soft-off-wakeup-sources";
        wakeup-sources = <&kscan0>;
    };
};
